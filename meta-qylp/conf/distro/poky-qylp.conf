## meta-qylp/conf/distro/poky-qylp.conf
```bitbake
require conf/distro/poky.conf

DISTRO = "poky-qylp"

SPLASH = "psplash-qylp"

DISTRO_FEATURES_append = " directfb opengl x11 alsa"
```

## meta-qylp/conf/layer.conf
```bitbake
# We have a conf and classes directory, add to BBPATH
BBPATH .= ":${LAYERDIR}"

# We have recipes-* directories, add to BBFILES
BBFILES += "${LAYERDIR}/recipes-*/*/*.bb \
	${LAYERDIR}/recipes-*/*/*.bbappend"

BBFILE_COLLECTIONS += "qylp"
BBFILE_PATTERN_qylp = "^${LAYERDIR}/"
BBFILE_PRIORITY_qylp = "6"
```
